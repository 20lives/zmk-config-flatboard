#include "split36.dtsi"

&default_transform {
    col-offset = <0>;
};

&kscan0 {
    row-gpios = <&pro_micro 21 (GPIO_ACTIVE_LOW | GPIO_PULL_UP)>,
                <&pro_micro 20 (GPIO_ACTIVE_LOW | GPIO_PULL_UP)>,
                <&pro_micro 19 (GPIO_ACTIVE_LOW | GPIO_PULL_UP)>,
                <&pro_micro 18 (GPIO_ACTIVE_LOW | GPIO_PULL_UP)>;

    col-gpios = <&pro_micro 15 GPIO_ACTIVE_LOW>,
                <&pro_micro 14 GPIO_ACTIVE_LOW>,
                <&pro_micro 16 GPIO_ACTIVE_LOW>,
                <&pro_micro 10 GPIO_ACTIVE_LOW>,
                <&pro_micro 1  GPIO_ACTIVE_LOW>;
};
